#include <dt-bindings/zmk/matrix_transform.h>

/ {
    chosen {
        zmk,kscan = &kscan0;
    };

    key_matrix: key_matrix {
        compatible = "zmk,matrix-transform";
        rows = <3>;
        columns = <4>;
        map = <
            0 1 2 3
            4 5 6 7
            8 9 10 11
        >;
    };

    kscan0: kscan {
        compatible = "zmk,kscan-gpio-matrix";
        diode-direction = "col2row";
        row-gpios = <&gpio0 6 (GPIO_ACTIVE_HIGH | GPIO_PULL_DOWN)>,
                    <&gpio0 8 (GPIO_ACTIVE_HIGH | GPIO_PULL_DOWN)>,
                    <&gpio0 17 (GPIO_ACTIVE_HIGH | GPIO_PULL_DOWN)>;
        col-gpios = <&gpio0 20 (GPIO_ACTIVE_LOW | GPIO_PULL_UP)>,
                    <&gpio0 22 (GPIO_ACTIVE_LOW | GPIO_PULL_UP)>,
                    <&gpio0 24 (GPIO_ACTIVE_LOW | GPIO_PULL_UP)>,
                    <&gpio0 9  (GPIO_ACTIVE_LOW | GPIO_PULL_UP)>;
    };
};
